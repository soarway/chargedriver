## Android-Q_v1.1/drivers/usb/sybc/Kconfig
```kconfig
# SPDX-License-Identifier: GPL-2.0-only
#
# USB Power Delivery driver configuration
#

config USB_SYBC_BQ2589X
	tristate "BQ2589X class support"
	default y
	help
	  Say Y here to enable BQ2589X class support. 
```

## Android-Q_v1.1/drivers/usb/sycharger/Kconfig
```kconfig
# SPDX-License-Identifier: GPL-2.0-only
#
# USB Power Delivery driver configuration
#

config USB_SY_MASTER
	tristate "sy master class support"
	default y
	help
	  Say Y here. 

config USB_SY_BC7D
	tristate "sy bc7d class support"
	default y
	help
	  Say Y here. 

config USB_SY_PD7E
	tristate "sy pd7e class support"
	default y
	help
	  Say Y here. 

config USB_SY_UF7F
	tristate "sy uf7f class support"
	default y
	help
	  Say Y here. 

config RT_REGMAP
	tristate "Richtek Regmap"
	select DEBUG_FS
	default m
	help
	  Say Y to enable Richtek Register Map (misc)

config DUAL_ROLE_USB_INTF
	tristate "Dual Role Class Device"
	default y
	help
	  Say Y to enable USB DUAL_ROLE Class

config TCPC_CLASS
	tristate "TypeC Port Controller Device Class"
	default y
	help
	  Say Y to enable
	  Typec Port
	  Controller Device
	  Class


config TCPC_RT1711H
	tristate "Richtek RT1711H TypeC port Controller Driver"
	depends on TCPC_CLASS
	default y
	help
	  Say Y to enable
	  Richtek RT1711H
	  TypeC port Controller
	  Driver


config USB_POWER_DELIVERY
	tristate "Support USB power delivery Function"
	default y
	help
	  Say Y to enable
	  USB
	  Power Delivery
	  support


config USB_PD_VBUS_STABLE_TOUT
	int "PD VBUS Stable Timeout"
	depends on USB_POWER_DELIVERY
	range 0 1000                       # >= 0,  <= 1000
	default 125
	help
          Setup a timeout value (ms)
	  for
	  VBUS change
	  stable

config USB_PD_VBUS_PRESENT_TOUT
	int "PD VBUS Present Timeout"
	depends on USB_POWER_DELIVERY
	range 0 1000                       # >= 0,  <= 1000
	default 20
	help
          Setup a timeout value (ms)
	  for
	  VBUS present
	  stable


menuconfig SWITCH
	tristate "Switch class support"
	default m
	help
	  Say Y here to enable switch class support. This allows
	  monitoring switches by userspace via sysfs and uevent.

if SWITCH

config SWITCH_GPIO
	tristate "GPIO Swith support"
	depends on GENERIC_GPIO
	default m
	help
	  Say Y here to enable GPIO based switch support.

config SWITCH_HD3SS460
	tristate "HD3SS460 Switch support"
	depends on GENERIC_GPIO
	default m
	help
	  Say Y here to enable TI HD3SS460 switch support (for DisplayPort).

endif # SWITCH
```

## Android-Q_v1.1/drivers/usb/sypd/Kconfig
```kconfig
config RT_REGMAP
	bool "Richtek Regmap"
	select DEBUG_FS
	default n
	help
	  Say Y to enable Richtek Register Map (misc)

config DUAL_ROLE_USB_INTF
	bool "Dual Role Class Device"
	help
	  Say Y to enable USB DUAL_ROLE Class

config TCPC_CLASS
	bool "TypeC Port Controller Device Class"
	default y
	help
	  Say Y to enable
	  Typec Port
	  Controller Device
	  Class

config USB_POWER_DELIVERY
	bool "Support USB power delivery Function"
	default y
	help
	  Say Y to enable
	  USB
	  Power Delivery
	  support


config TCPC_RT1711H
	bool "Richtek RT1711H TypeC port Controller Driver"
	depends on TCPC_CLASS
	default y
	help
	  Say Y to enable
	  Richtek RT1711H
	  TypeC port Controller
	  Driver

config USB_PD_VBUS_STABLE_TOUT
	int "PD VBUS Stable Timeout"
	depends on USB_POWER_DELIVERY
	range 0 1000                       # >= 0,  <= 1000
	default 125
	help
          Setup a timeout value (ms)
	  for
	  VBUS change
	  stable

config USB_PD_VBUS_PRESENT_TOUT
	int "PD VBUS Present Timeout"
	depends on USB_POWER_DELIVERY
	range 0 1000                       # >= 0,  <= 1000
	default 20
	help
          Setup a timeout value (ms)
	  for
	  VBUS present
	  stable


menuconfig SWITCH
	tristate "Switch class support"
	help
	  Say Y here to enable switch class support. This allows
	  monitoring switches by userspace via sysfs and uevent.

if SWITCH

config SWITCH_GPIO
	tristate "GPIO Swith support"
	depends on GENERIC_GPIO
	help
	  Say Y here to enable GPIO based switch support.

config SWITCH_HD3SS460
	tristate "HD3SS460 Switch support"
	depends on GENERIC_GPIO
	help
	  Say Y here to enable TI HD3SS460 switch support (for DisplayPort).

endif # SWITCH
```
